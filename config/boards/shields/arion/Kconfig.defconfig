## config/boards/shields/arion/Kconfig.defconfig
```kconfig
if SHIELD_ARION

config ZMK_KEYBOARD_NAME
    default "arion"

config I2C
	default y

endif
```

## config/boards/shields/arion/Kconfig.shield
```kconfig
config SHIELD_arionaryabhatta
    def_bool $(shields_list_contains,arionaryabhatta)
```

## config/boards/shields/arionaryabhatta/Kconfig.shield
```kconfig
config SHIELD_arixaaryabhatta
    def_bool $(shields_list_contains,arixaaryabhatta)
```
